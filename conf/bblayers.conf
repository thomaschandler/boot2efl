## conf/bblayers.conf
```bitbake
LCONF_VERSION = "6"

BBPATH = "${TOPDIR}"
BBFILES ?= ""

BBLAYERS ?= " \
  /home/ubuntu/boot2efl/src/oe-core/meta \
  /home/ubuntu/boot2efl/src/meta-openembedded/meta-oe \
  /home/ubuntu/boot2efl/src/meta-openembedded/meta-efl \
  /home/ubuntu/boot2efl/src/meta-boot2efl \
  "
```

## conf/local.conf
```bitbake
DISTRO ?= "boot2efl"
PACKAGE_CLASSES ?= "package_ipk"

DL_DIR ?= "/home/ubuntu/calaos-os/downloads"
SSTATE_DIR ?= "/home/ubuntu/calaos-os/sstate-cache"

CONF_VERSION = "1"
BB_DISKMON_DIRS = "\
    STOPTASKS,${TMPDIR},1G,100K \
    STOPTASKS,${DL_DIR},1G,100K \
    STOPTASKS,${SSTATE_DIR},1G,100K \
    ABORT,${TMPDIR},100M,1K \
    ABORT,${DL_DIR},100M,1K \
    ABORT,${SSTATE_DIR},100M,1K" 
PATCHRESOLVE = "noop"
USER_CLASSES ?= "buildstats image-mklibs image-prelink"
EXTRA_IMAGE_FEATURES = "debug-tweaks"
PREFERRED_PROVIDER_virtual/android-headers = "full-android"

#enable PR service
PRSERV_HOST = "localhost:0"
PACKAGE_FEED_URIS = "https://enna.me/boot2efl/"
```
